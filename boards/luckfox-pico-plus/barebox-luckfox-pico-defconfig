## boards/luckfox-pico-plus/barebox-luckfox-pico-defconfig
```kconfig
CONFIG_ARCH_ROCKCHIP=y
CONFIG_MACH_LUCKFOX_PICO=y
CONFIG_THUMB2_BAREBOX=y
CONFIG_MMU=y
CONFIG_MALLOC_TLSF=y
CONFIG_PROMPT="barebox> "
CONFIG_BAUDRATE=1500000
CONFIG_CMDLINE_EDITING=y
CONFIG_AUTO_COMPLETE=y
CONFIG_BOOTM_SHOW_TYPE=y
CONFIG_BOOTM_VERBOSE=y
CONFIG_BOOTM_INITRD=y
CONFIG_BOOTM_OFTREE=y
CONFIG_DEFAULT_ENVIRONMENT_GENERIC_NEW=y
CONFIG_CMD_RESET=y
CONFIG_CMD_PARTITION=y
CONFIG_CMD_PRINTENV=y
CONFIG_CMD_SAVEENV=y
CONFIG_CMD_MEMINFO=y
CONFIG_CMD_IOMEM=y
CONFIG_CMD_FILETYPE=y
CONFIG_CMD_LET=y
CONFIG_CMD_SLEEP=y
CONFIG_CMD_DETECT=y
CONFIG_CMD_OF_NODE=y
CONFIG_CMD_OF_PROPERTY=y
CONFIG_CMD_OFTREE=y
CONFIG_OFDEVICE=y
CONFIG_OF_BAREBOX_DRIVERS=y
CONFIG_DRIVER_SERIAL_NS16550=y
CONFIG_MCI=y
CONFIG_MCI_DW=y
CONFIG_FS_EXT4=y
CONFIG_FS_FAT=y
CONFIG_FS_FAT_WRITE=y
CONFIG_BANNER=y
```
